## esp32/firmware/receiver/main/Kconfig.projbuild
```kconfig
menu "CSI Receiver Configuration"

    menu "Wi-Fi"
        config CSI_WIFI_SSID
            string "Wi-Fi SSID"
            default "myssid"
            help
                2.4 GHz network to join. Note the channel this access point
                uses: the sender must be configured to the same channel.

        config CSI_WIFI_PASSWORD
            string "Wi-Fi password"
            default "mypassword"
    endmenu

    menu "MQTT"
        config CSI_MQTT_BROKER_URL
            string "Broker URL"
            default "mqtt://192.168.1.100:1883"
            help
                Use your laptop's LAN IP, not localhost.

        config CSI_MQTT_TELEMETRY_TOPIC
            string "Telemetry topic"
            default "room-detector/motion-events"
            help
                Topic the 1-second motion telemetry is published to (QoS 1).
                Must match MQTT_MOTION_EVENTS_TOPIC in the backend.

        config CSI_MQTT_USERNAME
            string "Username (optional)"
            default ""

        config CSI_MQTT_PASSWORD
            string "Password (optional)"
            default ""
    endmenu

    menu "Identity"
        config CSI_ROOM_ID
            string "Room ID"
            default "study-room-2"
            help
                Must match a room_id in backend/rooms.yaml.

        config CSI_DEVICE_ID
            string "Device ID"
            default "esp32-rx-01"
    endmenu

    choice CSI_SOURCE
        prompt "CSI source"
        default CSI_SOURCE_ROUTER
        help
            Where the measured packets come from. Can be overridden with
            CSI_SOURCE=router|sender in .env.

        config CSI_SOURCE_ROUTER
            bool "Router (one ESP32: ping the Wi-Fi router, measure its replies)"
        config CSI_SOURCE_SENDER
            bool "Sender board (two ESP32s: measure the sender's broadcasts)"
    endchoice

    config CSI_ROUTER_PING_HZ
        int "Router pings per second"
        depends on CSI_SOURCE_ROUTER
        range 10 200
        default 100

    config CSI_SENDER_MAC
        string "Sender MAC address (aa:bb:cc:dd:ee:ff)"
        default ""
        help
            Only used when the CSI source is the sender board.
            Only CSI from this MAC is used. The sender prints its MAC at boot.
            Leave empty during bring-up to accept CSI from any transmitter
            (not recommended for real measurements).

    config CSI_SNTP_SERVER
        string "SNTP server"
        default "pool.ntp.org"

    config CSI_HEARTBEAT_INTERVAL_S
        int "Heartbeat interval (seconds)"
        range 10 3600
        default 60

    config CSI_MIN_AMPLITUDE_X10
        int "Minimum valid subcarrier amplitude (x0.1)"
        range 0 100
        default 10
        help
            Subcarriers whose amplitude is below this value (in tenths) are
            treated as null/guard subcarriers and excluded. 10 = 1.0.

    config CSI_PERSIST_BASELINE
        bool "Keep calibration across reboots (save to flash)"
        default n
        help
            Off: every boot starts uncalibrated and the empty-room baseline
            lives only in RAM - send the calibrate command after each boot.
            On: the baseline is saved to NVS and reloaded at boot.

    config CSI_LOG_TIMEZONE
        string "Time zone for serial log clock (POSIX TZ)"
        default "SGT-8"
        help
            Only affects the HH:MM:SS shown in serial log lines. Telemetry
            timestamps are always UTC. Example: "SGT-8" (Singapore, UTC+8).

    config CSI_LOG_WINDOWS
        bool "Log each 1-second feature window"
        default y

    config CSI_DEBUG_RAW
        bool "Debug: print raw CSI over USB serial"
        default n
        help
            Prints lines of the form CSI_DATA,<rssi>,<len>,[im,re,...].
            At 100 Hz this floods a 115200 baud console, so only every Nth
            packet is printed.

    config CSI_DEBUG_PRINT_EVERY_N
        int "Print every Nth packet"
        depends on CSI_DEBUG_RAW
        range 1 1000
        default 10

endmenu
```

## firmware/sender/main/Kconfig.projbuild
```kconfig
menu "CSI Sender Configuration"

    config CSI_SEND_CHANNEL
        int "Wi-Fi channel"
        range 1 13
        default 6
        help
            Fixed 2.4 GHz channel used to broadcast packets. This MUST be the
            same channel as the access point the receiver connects to,
            otherwise the receiver never hears the sender.

    config CSI_SEND_FREQUENCY_HZ
        int "Packets per second"
        range 10 500
        default 100
        help
            Broadcast rate. 100 Hz matches what the receiver expects
            (the backend ignores windows with fewer than 50 packets/s).

    config CSI_SEND_PAYLOAD_LEN
        int "Payload length (bytes)"
        range 16 250
        default 32
        help
            Size of each ESP-NOW broadcast. Small payloads keep airtime low.

    config CSI_SEND_USE_CUSTOM_MAC
        bool "Use a custom station MAC address"
        default n
        help
            By default the board's factory MAC is used and printed at boot.
            Enable this to force a fixed, easy-to-remember MAC so the receiver
            configuration does not change if you swap sender boards.

    config CSI_SEND_CUSTOM_MAC
        string "Custom MAC (aa:bb:cc:dd:ee:ff)"
        depends on CSI_SEND_USE_CUSTOM_MAC
        default "1a:00:00:00:00:01"
        help
            Must be a unicast address (first byte even).

    config CSI_SEND_STATS_INTERVAL_S
        int "Statistics log interval (seconds)"
        range 1 3600
        default 10

endmenu
```
